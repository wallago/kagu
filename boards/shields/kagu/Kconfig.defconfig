## config/boards/shields/kagu/Kconfig.shield
```kconfig
config SHIELD_KAGU_LEFT
      def_bool $(shields_list_contains,kagu_left)

config SHIELD_KAGU_RIGHT
      def_bool $(shields_list_contains,kagu_right)
```
