#include <dt-bindings/zmk/matrix_transform.h>

/ {
      chosen {
              zmk,kscan = &kscan0;
              zmk,matrix-transform = &default_transform;
      };

      kscan0: kscan {
              compatible = "zmk,kscan-gpio-matrix";
              diode-direction = "col2row";
              wakeup-source;

              col-gpios = <&gpio0 2 GPIO_ACTIVE_HIGH>;                       // D0
              row-gpios = <&gpio0 3 (GPIO_ACTIVE_HIGH | GPIO_PULL_DOWN)>;    // D1
      };

      default_transform: keymap_transform {
              compatible = "zmk,matrix-transform";
              columns = <1>;
              rows = <1>;
              map = <RC(0,0)>;
      };
};
