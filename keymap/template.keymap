// Template for kagu.keymap: keymap/generate.py fills in the #...# markers
// from keymap.txt.
#include <behaviors.dtsi>
#include <dt-bindings/zmk/keys.h>
#include <dt-bindings/zmk/bt.h>
#include <dt-bindings/zmk/outputs.h>
#include <dt-bindings/zmk/pointing.h>

#LAYER_DEFINES#

// Key positions (see the matrix transform in kagu.dtsi):
//   0  1  2  3  4     5  6  7  8  9
//  10 11 12 13 14    15 16 17 18 19
//  20 21 22 23 24    25 26 27 28 29
//        30 31 32    33 34 35
#define KEYS_L 0 1 2 3 4 10 11 12 13 14 20 21 22 23 24
#define KEYS_R 5 6 7 8 9 15 16 17 18 19 25 26 27 28 29
#define THUMBS 30 31 32 33 34 35

// Thumb layer-taps: tapping a thumb then holding it repeats the tap
// (hold Space or Backspace) instead of turning on the layer.
&lt {
	quick-tap-ms = <175>;
};

/ {
	behaviors {
		// Home row mods. A mod only fires when the next key is on the other
		// hand (or a thumb), so same-hand rolls like "st" stay letters.
		hml: homerow_mods_left {
			compatible = "zmk,behavior-hold-tap";
			#binding-cells = <2>;
			flavor = "balanced";
			tapping-term-ms = <280>;
			quick-tap-ms = <175>;
			require-prior-idle-ms = <150>;
			bindings = <&kp>, <&kp>;
			hold-trigger-key-positions = <KEYS_R THUMBS>;
			hold-trigger-on-release;
		};

		hmr: homerow_mods_right {
			compatible = "zmk,behavior-hold-tap";
			#binding-cells = <2>;
			flavor = "balanced";
			tapping-term-ms = <280>;
			quick-tap-ms = <175>;
			require-prior-idle-ms = <150>;
			bindings = <&kp>, <&kp>;
			hold-trigger-key-positions = <KEYS_L THUMBS>;
			hold-trigger-on-release;
		};

		// One-shot keys (`LSHFT/LSHFT`, `sym/sym`): a tap applies the modifier
		// or layer to the next key press, a hold is momentary.
		osm: oneshot_mod_tap {
			compatible = "zmk,behavior-hold-tap";
			#binding-cells = <2>;
			flavor = "tap-preferred";
			tapping-term-ms = <200>;
			bindings = <&kp>, <&sk>;
		};

		osl: oneshot_layer_tap {
			compatible = "zmk,behavior-hold-tap";
			#binding-cells = <2>;
			flavor = "tap-preferred";
			tapping-term-ms = <200>;
			bindings = <&mo>, <&sl>;
		};
#LAYER_MOD_BEHAVIORS#
	};

#COMBOS#

	keymap {
		compatible = "zmk,keymap";

#LAYERS#
	};
};
